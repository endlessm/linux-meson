## amlogic.its
```
/dts-v1/;
/ {
	description = "Amlogic kernel and FDT";
	#address-cells = <1>;

	images {
		kernel@1 {
			description = "Linux 3.x";
			data = /incbin/("arch/arm/boot/zImage");
			type = "kernel";
			arch = "arm";
			os = "linux";
			compression = "none";
			load = <0x00208000>;
			entry = <0x00208000>;
			hash@1 {
				algo = "crc32";
			};
		};
		fdt@1 {
			description = "Amlogic M201 Flattened Device Tree blob";
			data = /incbin/("arch/arm/boot/dts/meson8b_m201_1G.dtb");
			type = "flat_dt";
			arch = "arm";
			compression = "none";
			hash@1 {
				algo = "crc32";
			};
		};
	};

	configurations {
		default = "conf@1";
		conf@1 {
			description = "Boot Amlogic M201";
			kernel = "kernel@1";
			fdt = "fdt@1";
		};
	};
};
```

## arch/arm/mach-meson8/Kconfig.boards
```kconfig
if ARCH_MESON8

config MACH_MESON8_COMMON_BOARD
	depends on ARCH_MESON8
	bool "Meson8 common board"
	default y 
	help
      Support for Amlogic Meson8 common development platform.

endif # ARCH_MESON8
```

## drivers/amlogic/boot_monitor/Kconfig
```kconfig
menu "Amlogic BOOT MONITOR SYSFS"

config BOOT_MONITOR
	bool "BOOT MONITOR SYSFS"
	default n
	---help---
	  This module adds support for boot monitor sysfs.

endmenu
```

## drivers/amlogic/cpufreq/Kconfig
```kconfig
config AMLOGIC_MESON_CPUFREQ
	bool "Meson CPU Frequency scaling support"
	depends on PLAT_MESON
	help
	  This adds the CPUFreq driver for Meson series CPU

config FIX_SYSPLL
    bool "Meson CPU Fix syspll mode support"
    help
        This add fix sys pll mode support for M8baby
```

## drivers/amlogic/display/backlight/Kconfig
```kconfig
menu "Amlogic Backlight Support"

config AMLOGIC_BACKLIGHT
	bool "Amlogic backlight support"
	select BACKLIGHT_CLASS_DEVICE
	default y
	help
		Say Y here if you want to use the Amlogic backlight management.

config AML_BACKLIGHT_EXTERN
	boolean "AML backlight extern driver IC support"
	default y
	depends on AMLOGIC_BACKLIGHT
	help
		AML backlight extern driver IC support

if  AML_BACKLIGHT_EXTERN
source "drivers/amlogic/display/backlight/aml_bl_extern/Kconfig"
endif

config AMLOGIC_TV_BACKLIGHT
	bool "Amlogic TV backlight support"
	select BACKLIGHT_CLASS_DEVICE
	default n
	help
		Amlogic TV backlight management.

config AML_BL_LATCH_ON_VSYNC
	bool "Backlight latch on vsync"
	depends on AMLOGIC_TV_BACKLIGHT
	default n
	help
	  Say Y if you want to enable the Amlogic backlight latch on vsync.

config AML_BL_PWM_ATTR
	bool "Backlight sys class attr"
	depends on AMLOGIC_TV_BACKLIGHT
	default n
	help
	  Say Y if you want to enable the Amlogic backlight sys pwm attr.

config AML_LOCAL_DIMMING
	bool "Amlogic Local Dimming"
	depends on AMLOGIC_TV_BACKLIGHT
	default n
	help
	  Amlogic local dimming support.

config IW7023_BACKLIGHT
	bool "iW7023 Backlight"
	depends on AMLOGIC_TV_BACKLIGHT
	default n
	help
	  iW7023 LED Driver for LCD Panel Backlight.

config IW7023_USE_EEPROM
	bool "iW7023 use eeprom to backup data"
	depends on AMLOGIC_TV_BACKLIGHT
	default n
	help
	  Say Y if you use eeprom to backup data of iw7023.

endmenu
```

## drivers/amlogic/display/backlight/aml_bl_extern/Kconfig
```kconfig
menu "Amlogic Backlight Extern Support"

config AML_BL_EXTERN_PMU_AML1218
	boolean "AML bl extern pmu_aml1218 support"
	default y
	help
		AML bl extern pmu_aml1218 support

config AML_BL_EXTERN_MIPI_LT070ME05
	boolean "AML bl extern mipi_LT070ME05 support"
	default n
	help
		AML bl extern mipi_LT070ME05 support

config AML_BL_EXTERN_I2C_LP8556
	boolean "AML bl extern i2c_lp8556 support"
	default n
	help
		AML bl extern i2c_lp8556 support


endmenu
```

## drivers/amlogic/display/lcd/Kconfig
```kconfig
#
# Kconfig for Amlogic LCD Devices
#

menuconfig AMLOGIC_LCD
	bool "Amlogic LCD support"
	default n
	help
	  Amlogic LCD modules and controls

if AMLOGIC_LCD

config AML_LCD_TV
	bool "Amlogic TV LCD module"
	default n
	help
	  Amlogic TV LCD module support

source "drivers/amlogic/display/lcd/aml_lcd_extern/Kconfig"

endif
```

## drivers/amlogic/display/lcd/aml_lcd_extern/Kconfig
```kconfig
#
# lcd extern driver configuration
#

menuconfig AML_LCD_EXTERN
	tristate "Amlogic lcd extern driver support"
	default n
	help
		Amlogic video output support

if AML_LCD_EXTERN

config AML_LCD_EXTERN_I2C_T5800Q
	boolean "Amlogic i2c T5800Q lcd extern driver support"
	default n
	help
		Video output and control module support

config AML_LCD_EXTERN_I2C_TC101
	boolean "Amlogic i2c tc101 lcd extern driver support"
	default n
	help
		framerate adjustment automatically from video source

config AML_LCD_EXTERN_I2C_ANX6345
	boolean "Amlogic i2c anx6345 lcd extern driver support"
	default n
	help
		vdac hardware switch of cvbs/ypbpr for mx.

config AML_LCD_EXTERN_SPI_LD070WS2
	boolean "Amlogic spi LD070WS2 lcd extern driver support"
	default n
	help
		Tablet LCD output module support

config AML_LCD_EXTERN_MIPI_N070ICN
	boolean "Amlogic mipi N070ICN lcd extern driver support"
	default n
	help
		Tablet LCD output module support

config AML_LCD_EXTERN_MIPI_KD080D13
	boolean "Amlogic mipi KD080D13 lcd extern driver support"
	default n
	help
		Tablet LCD output module support

endif
```

## drivers/amlogic/display/vout/Kconfig
```kconfig
#
# Video output configuration
#

menuconfig AMLOGIC_VOUT
	tristate "Amlogic video output support"
	default n
	help
		Amlogic video output support

if AMLOGIC_VOUT

config AML_TVOUT
	tristate "Video output and control module"
	default n
	help
		Video output and control module support

config AML_VOUT_FRAMERATE_AUTOMATION
	bool "framerate automation"
	default n
	depends on AML_TVOUT
	help
		framerate adjustment automatically from video source

config AML_VDAC_HW_SWITCH
	bool "vdac hardware switch"
	default n
	depends on AML_TVOUT
	help
		vdac hardware switch of cvbs/ypbpr for mx.

config AML_LCD_TABLET
	tristate "Tablet LCD output module"
	default n
	help
		Tablet LCD output module support

config AML_GAMMA_DEBUG
	tristate "gamma debug"
	default n
	depends on  AML_LCD_TABLET
	help
		gamma debug support

endif
```

## drivers/amlogic/display/vout2/Kconfig
```kconfig
#
# Video output configuration
#

menuconfig AMLOGIC_VOUT2
	tristate "Amlogic video output2 support"
	default n
	help
		Amlogic video output2 support

if AMLOGIC_VOUT2

config AML_TVOUT2
	tristate "Video output2 and control module"
	default n
	help
		Video output and control module support

endif
```

## drivers/amlogic/hdmi/Kconfig
```kconfig
menu "HDMI TX Support"

config AML_HDMI_TX_20
        bool "HDMI 2.0 Output Enable"
        default n
        select SWITCH
        select AM_DISPLAY_MODULE
        help  
                hdmi 2.0 output enable. It should be enalbe if board have hdmi 2.0 out interface

config AML_HDMI_TX
        bool "HDMI 1.4 Output Enable"
        default y
        select SWITCH
        select AM_DISPLAY_MODULE
        help
                hdmi 1.4 output enable, It should be enalbe if board have hdmi 1.4 out interface

if AML_HDMI_TX || AML_HDMI_TX_20
config AML_HDMI_TX_HDCP
        bool "HDMI HDCP Enable"
        default n
        help
                hdmitx hdcp enable, it should be enalbe if board burned hdmitx hdcp keys
endif

config AML_HDMI_TX_CTS_DVI
        bool "HDMI DVI mode Output Enable"
        default n
        help
                HDMI DVI output enable. By default, Tx will output HDMI mode signal, not DVI.
                If you want to pass HDMI official CTS or compliance DVI device, enable it.

endmenu
```

## drivers/amlogic/input/Kconfig
```kconfig
#
# Input device configuration
#

menu "Meson Input device support"

source "drivers/amlogic/input/saradc/Kconfig"
source "drivers/amlogic/input/remote/Kconfig"
source "drivers/amlogic/input/new_remote/Kconfig"
source "drivers/amlogic/input/keyboard/Kconfig"
source "drivers/amlogic/input/touchscreen/Kconfig"
source "drivers/amlogic/input/simcard_detect/Kconfig"
source "drivers/amlogic/input/holdkey/Kconfig"
source "drivers/amlogic/input/call_key/Kconfig"
source "drivers/amlogic/input/sensor/Kconfig"
source "drivers/amlogic/input/gpio_key/Kconfig"

endmenu
```

## drivers/amlogic/jtag/Kconfig
```kconfig
menu "Amlogic JTAG Support"


config AMLOGIC_JTAG
	bool "Amlogic JTAG Support"
	default n
	help
		Amlogic JTAG support.

if AMLOGIC_JTAG
config AML_JTAG_CONTROL
	bool "jtag control support"
	default n
	help
		Amlogic jtag control module.

endif

endmenu
```

## drivers/amlogic/led/Kconfig
```kconfig
#
# LED drivers configuration
#

menuconfig AMLOGIC_LED
	tristate "Amlogic LED Support"
	default n
	help
	  Say Y here to get to see options for led drivers.
	  This option alone does not add any kernel code.

	  If you say N, all options in this submenu will be
	  skipped and disabled.


if AMLOGIC_LED

config AML_LED_SYS
	tristate "common sys led module support"
	depends on LEDS_CLASS
	default n
	help
	  This option enables support for system led drivers.

	  Enable this option to allow the userspace to control
	  the system led.

config AML_TV_LED
	tristate "tv led module support"
	default n
	help
		Amlogic TV LED management.

config AMLOGIC_SYS_LED
	bool "old sys led module support"
	select SETIO_CLASS_DEVICE
	default y
	help
	  Say Y here if you want to use the amlogic system led management.


endif
```

## drivers/amlogic/projector/Kconfig
```kconfig
#
# Input core configuration
#



config AML_PROJECTOR
	tristate "Amlogic Projector driver"
	depends on I2C_AML
	default n
	help
	  Say Y here if you want to use the amlogic ADC sim card detect.
```

## drivers/amlogic/watchdog/Kconfig
```kconfig
#
# watchdog configuration
#

menuconfig AML_WATCHDOG
	bool "Watchdog Support"
	default n

if AML_WATCHDOG

#config AML_WDT
#	bool "Amlogic Watchdog"
#	default n
#	help
#	  This module works as watch dog for platform.

config AML_WDT_TV
	bool "Amlogic TV Watchdog"
	default n
	help
	  Amlogic tv watchdog timer embedded in chip.

endif
```
